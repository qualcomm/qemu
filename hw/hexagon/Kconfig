## hw/hexagon/Kconfig
```kconfig
config HEX_DSP
    bool
    default y
    depends on HEXAGON && TCG
    imply PTIMER
    select L2VIC
    select ARM_COMPATIBLE_SEMIHOSTING
    select TCSR
    select DSPSS_PUB

config HEX_VIRT
    bool
    default y
    depends on HEX_DSP && FDT
    select DEVICE_TREE
    select VIRTIO_MMIO
    select PL011
    select X_QUP_GENI_UART_RUST if HAVE_RUST
    select QUP_WRAPPER if HAVE_RUST
    select VIRTIO_BLK
    select VIRTIO_SCSI
```

## hw/qcom/Kconfig
```kconfig
source graphics/Kconfig
source cc/Kconfig
source smmu/Kconfig

config QCOM_CRM_V2
    bool

config QCOM_CMD_DB
    bool

config QCOM_RPMH_RSC
    bool

config QCOM_RPMH_CLK
    bool

config QCOM_ICC_RPMH
    bool

config QCOM_QMP
    bool
```

## hw/ufs/Kconfig
```kconfig
config UFS
    bool
    default y if SCSI

config UFS_PCI
    bool
    default y if PCI_DEVICES
    depends on PCI && UFS
```
